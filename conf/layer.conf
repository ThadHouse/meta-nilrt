## conf/layer.conf
```bitbake
# We have a conf directory, add to BBPATH
BBPATH .= ":${LAYERDIR}"

# We have a recipes directory containing .bb and .bbappend files, add to BBFILES
BBFILES += "${LAYERDIR}/recipes-*/*/*.bb \
            ${LAYERDIR}/recipes-*/*/*.bbappend"

BBFILE_COLLECTIONS += "meta-nilrt"
BBFILE_PATTERN_meta-nilrt = "^${LAYERDIR}/"
BBFILE_PRIORITY_meta-nilrt = "15"

LAYERSERIES_COMPAT_meta-nilrt = "sumo"

FORTRAN_forcevariable = ",fortran"
RUNTIMETARGET_append_pn-gcc-runtime = " libquadmath"

PREFERRED_VERSION_libgfortran="7.3.0"
PREFERRED_VERSION_nativesdk_libgfortran="7.3.0"
```
